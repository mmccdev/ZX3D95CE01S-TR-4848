## main/Kconfig.projbuild
```kconfig
menu "Main Config"

    config MAIN_AVGBUF
        int "Size of buffer for averaging the measurements"
    range 2 200
    default 20
    config MAIN_TIME_RECHECK
        int "Timeout time in minutes to wait for recheck battery full"
    range 2 200
    default 60
    config MAIN_VOLTFULL
        int "Voltage * 10 at which to consider te battery full"
    range 1200 6400
    default 1400       
    config MAIN_AMPSOLARINVERTEROFF
        int "Amps from the solar panel * 10 below which to consider switching off the inverter"
    range 1200 60000
    default 15000
    config MAIN_AMPINVERTEROFF
        int "Amps the inverter delivers * 10 below which to consider switching off the inverter"
    range 1200 6400
    default 2400       
    choice WT_BOARD
        prompt "Select board"
        
#        default WT32_SC01
#        config WT32_SC01
#            bool "WT32_SC01"
#        config WT154_S2MI1
#            bool "WT154_S2MI1"
#        config WT154_C3SI1
#            bool "WT154_C3SI1"
#        config WT_86_32_3ZW0
#            bool "WT_86_32_3ZW0"
#        config WT_86_32_3ZW1
#            bool "WT_86_32_3ZW1"
#        config WT280_S2MX1
#            bool "WT280_S2MX1"
#        config WT240_C3SI1
#            bool "WT240_C3SI1"
#        config WT_0_S2_240MW1
#            bool "WT-0-S2-240MW1"
        config ZX4D30NE01S_UR_4827
            bool "ZX4D30NE01S-UR-4827"
#        config ZX3D95CE01S_UR_4848
#            bool "ZX3D95CE01S-UR-4848"
#        config ZX3D95CE01S_AR_4848
#            bool "ZX3D95CE01S-AR-4848"
        config ZX3D95CE01S_TR_4848
            bool "ZX3D95CE01S-TR-4848"
#        config ZX3D50CE02S_USRC_4832
#            bool "ZX3D50CE02S-USRC-4832"
#        config ZX3D92CE01S_cGS01_AR_3232
#            bool "ZX3D92CE01S-cGS01-AR-3232"
#        config ZX2D10GE01R_V_4848
#            bool "ZX2D10GE01R-V-4848"
#        config ZX4D60_AR_4896
#            bool "ZX4D60_AR_4896"
#        config ZX210_S3MLW1
#            bool "ZX210_S3MLW1"
        config ZX7D00CE01S_UR_8048
            bool "ZX7D00CE01S_UR_8048"
        config CUSTOM_LCD
            bool "CUSTOM_LCD"
    endchoice

    choice SCREEN_TORATION
        prompt "Screen totation"
        default SCREEN_ROLL_0
        config SCREEN_ROLL_0
            bool "0°"
        config SCREEN_ROLL_1
            bool "180°"
        config SCREEN_ROLL_2
            bool "90°"
        config SCREEN_ROLL_3
            bool "270°"
    endchoice
endmenu
```
